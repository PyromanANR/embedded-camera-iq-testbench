## CMakeLists.txt
```
cmake_minimum_required(VERSION 3.20.0)

find_package(Zephyr REQUIRED HINTS $ENV{ZEPHYR_BASE})
project(simcam_firmware)

target_sources(app PRIVATE
    src/main.c
    src/app_state.c
    src/power_budget.c
    src/telemetry_protocol.c
    src/uart_protocol.c
    src/i2c_als_sensor.c
    src/spi_image_sensor.c
    src/camera_control.c
    src/fault_injection.c
)

target_include_directories(app PRIVATE include)
```

## prj.conf
```kconfig
CONFIG_PRINTK=y
CONFIG_STDOUT_CONSOLE=y
CONFIG_MAIN_STACK_SIZE=2048
```

## src/main.c
```c
#include "app_state.h"
#include "camera_control.h"
#include "fault_injection.h"
#include "i2c_als_sensor.h"
#include "spi_image_sensor.h"
#include "telemetry_protocol.h"
#include "uart_protocol.h"

#if __has_include(<zephyr/kernel.h>)
#include <zephyr/kernel.h>
#define SIMCAM_SLEEP_MS(ms) k_msleep(ms)
#else
#define SIMCAM_SLEEP_MS(ms) ((void)(ms))
#endif

int main(void) {
    app_state_t app;
    simcam_telemetry_t telemetry;
    char packet[192];

    app_state_init(&app);
    i2c_als_init();
    spi_image_sensor_init();
    camera_control_set_mode(CAMERA_MODE_STOCK);

    app_state_set(&app, SIMCAM_IDLE);

    while (1) {
        app_state_set(&app, SIMCAM_CAPTURE);
        app.frame_counter++;
        if ((app.frame_counter % 45U) == 0U && app.battery_percent > 5U) {
            app.battery_percent--;
        }
        app.error_code = fault_injection_error_code();

        camera_control_fill_telemetry(&telemetry, app.frame_counter, app.battery_percent, app.error_code);
        telemetry_format_packet(&telemetry, packet, sizeof(packet));

        app_state_set(&app, SIMCAM_TRANSMIT);
        uart_protocol_send(packet);

        app_state_set(&app, SIMCAM_SLEEP);
        SIMCAM_SLEEP_MS(1000);
    }

    return 0;
}
```

## include/app_state.h
```c
#pragma once

#include <stdint.h>

typedef enum {
    SIMCAM_BOOT = 0,
    SIMCAM_IDLE,
    SIMCAM_CAPTURE,
    SIMCAM_TRANSMIT,
    SIMCAM_SLEEP,
    SIMCAM_ERROR
} simcam_state_t;

typedef struct {
    simcam_state_t state;
    uint32_t frame_counter;
    uint8_t battery_percent;
    uint8_t error_code;
} app_state_t;

void app_state_init(app_state_t *app);
void app_state_set(app_state_t *app, simcam_state_t state);
const char *app_state_name(simcam_state_t state);
```

## include/camera_control.h
```c
#pragma once

#include "telemetry_protocol.h"

typedef enum {
    CAMERA_MODE_STOCK = 0,
    CAMERA_MODE_BLURRY,
    CAMERA_MODE_NOISY,
    CAMERA_MODE_OVEREXPOSED,
    CAMERA_MODE_UNDEREXPOSED,
    CAMERA_MODE_LOW_LIGHT
} camera_mode_t;

void camera_control_set_mode(camera_mode_t mode);
camera_mode_t camera_control_get_mode(void);
void camera_control_fill_telemetry(simcam_telemetry_t *telemetry, uint32_t frame, uint8_t battery_percent, uint8_t error_code);
```

## include/fault_injection.h
```c
#pragma once

#include <stdint.h>

uint8_t fault_injection_error_code(void);
void fault_injection_set_error(uint8_t error_code);
```

## include/i2c_als_sensor.h
```c
#pragma once

#include <stdint.h>

void i2c_als_init(void);
uint16_t i2c_als_read_lux(void);
void i2c_als_set_lux(uint16_t lux);
uint16_t i2c_als_read_reg(uint8_t reg);
void i2c_als_write_reg(uint8_t reg, uint16_t value);

#define ALS_REG_CONFIG 0x00
#define ALS_REG_LUX 0x01
```

## include/power_budget.h
```c
#pragma once

#include <stdint.h>
#include "app_state.h"

#define MCU_SLEEP_MW 5
#define MCU_IDLE_MW 20
#define MCU_ACTIVE_MW 35
#define IMAGE_SENSOR_MW 120
#define WIFI_TX_MW 300
#define WLED_MW 450
#define IR_LED_MW 380
#define UART_DEBUG_MW 5

typedef enum {
    LED_OFF = 0,
    LED_WHITE,
    LED_IR
} led_mode_t;

uint16_t power_budget_estimate_mw(simcam_state_t state, led_mode_t led_mode);
```

## include/spi_image_sensor.h
```c
#pragma once

#include <stdint.h>

void spi_image_sensor_init(void);
uint16_t spi_image_sensor_read_reg(uint8_t reg);
void spi_image_sensor_write_reg(uint8_t reg, uint16_t value);

#define IMAGE_SENSOR_REG_ID 0x00
#define IMAGE_SENSOR_REG_EXPOSURE 0x01
#define IMAGE_SENSOR_REG_GAIN 0x02
#define IMAGE_SENSOR_REG_FRAME_STATUS 0x03
```

## include/telemetry_protocol.h
```c
#pragma once

#include <stddef.h>
#include <stdint.h>
#include "power_budget.h"

typedef struct {
    uint32_t frame;
    float temperature_c;
    uint8_t battery_percent;
    uint16_t lux;
    float exposure_ms;
    float gain;
    led_mode_t led_mode;
    uint16_t power_mw;
    uint8_t error_code;
} simcam_telemetry_t;

uint8_t telemetry_crc8(const char *payload);
int telemetry_format_packet(const simcam_telemetry_t *telemetry, char *buffer, size_t buffer_size);
```

## include/uart_protocol.h
```c
#pragma once

void uart_protocol_send(const char *packet);
```

## src/app_state.c
```c
#include "app_state.h"

void app_state_init(app_state_t *app) {
    app->state = SIMCAM_BOOT;
    app->frame_counter = 0;
    app->battery_percent = 87;
    app->error_code = 0;
}

void app_state_set(app_state_t *app, simcam_state_t state) {
    app->state = state;
}

const char *app_state_name(simcam_state_t state) {
    switch (state) {
    case SIMCAM_BOOT: return "BOOT";
    case SIMCAM_IDLE: return "IDLE";
    case SIMCAM_CAPTURE: return "CAPTURE";
    case SIMCAM_TRANSMIT: return "TRANSMIT";
    case SIMCAM_SLEEP: return "SLEEP";
    case SIMCAM_ERROR: return "ERROR";
    default: return "UNKNOWN";
    }
}
```

## src/camera_control.c
```c
#include "camera_control.h"

#include "i2c_als_sensor.h"
#include "power_budget.h"

static camera_mode_t active_mode = CAMERA_MODE_STOCK;

static int16_t telemetry_jitter(uint32_t frame, uint8_t period, int16_t amplitude) {
    int16_t phase = (int16_t)((frame / 2U) % period);
    int16_t center = (int16_t)(period / 2U);
    return (int16_t)((phase - center) * amplitude);
}

void camera_control_set_mode(camera_mode_t mode) {
    active_mode = mode;
}

camera_mode_t camera_control_get_mode(void) {
    return active_mode;
}

void camera_control_fill_telemetry(simcam_telemetry_t *telemetry, uint32_t frame, uint8_t battery_percent, uint8_t error_code) {
    int16_t lux_jitter = telemetry_jitter(frame, 7, 6);
    int16_t temp_jitter = telemetry_jitter(frame, 5, 1);
    int16_t exposure_jitter = telemetry_jitter(frame, 5, 1);
    int16_t gain_jitter = telemetry_jitter(frame, 5, 1);

    telemetry->frame = frame;
    telemetry->temperature_c = 42.5f + ((float)temp_jitter * 0.1f);
    telemetry->battery_percent = battery_percent;
    telemetry->lux = (uint16_t)((int16_t)i2c_als_read_lux() + lux_jitter);
    telemetry->exposure_ms = 8.3f + ((float)exposure_jitter * 0.1f);
    telemetry->gain = 1.4f + ((float)gain_jitter * 0.05f);
    telemetry->led_mode = LED_OFF;
    telemetry->error_code = error_code;

    if (active_mode == CAMERA_MODE_LOW_LIGHT) {
        telemetry->lux = 18;
        telemetry->exposure_ms = 33.0f;
        telemetry->gain = 6.0f;
        telemetry->led_mode = LED_IR;
    } else if (active_mode == CAMERA_MODE_NOISY) {
        telemetry->gain = 7.5f;
    } else if (active_mode == CAMERA_MODE_OVEREXPOSED) {
        telemetry->lux = 1200;
        telemetry->exposure_ms = 18.0f;
    } else if (active_mode == CAMERA_MODE_UNDEREXPOSED) {
        telemetry->lux = 45;
        telemetry->exposure_ms = 3.0f;
    }

    telemetry->power_mw = power_budget_estimate_mw(SIMCAM_CAPTURE, telemetry->led_mode);
    telemetry->power_mw = (uint16_t)(telemetry->power_mw + (uint16_t)((frame / 2U) % 5U) * 4U);
}
```

## src/fault_injection.c
```c
#include "fault_injection.h"

static uint8_t simulated_error_code = 0;

uint8_t fault_injection_error_code(void) {
    return simulated_error_code;
}

void fault_injection_set_error(uint8_t error_code) {
    simulated_error_code = error_code;
}
```

## src/i2c_als_sensor.c
```c
#include "i2c_als_sensor.h"

static uint16_t registers[2];

void i2c_als_init(void) {
    registers[ALS_REG_CONFIG] = 0x0001;
    registers[ALS_REG_LUX] = 320;
}

uint16_t i2c_als_read_lux(void) {
    return registers[ALS_REG_LUX];
}

void i2c_als_set_lux(uint16_t lux) {
    registers[ALS_REG_LUX] = lux;
}

uint16_t i2c_als_read_reg(uint8_t reg) {
    return registers[reg & 0x01];
}

void i2c_als_write_reg(uint8_t reg, uint16_t value) {
    registers[reg & 0x01] = value;
}
```
